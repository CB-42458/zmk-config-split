## config/boards/shields/redox_mod/Kconfig.defconfig
```kconfig
if REDOX_MOD_LEFT

config ZMK_KEYBOARD_NAME
    default "Redox Mod"

config ZMK_SPLIT_ROLE_CENTRAL
    default y

endif


if REDOX_MOD_LEFT || REDOX_MOD_RIGHT

config ZMK_SPLIT
    default y

endif
```

## config/boards/shields/redox_mod/Kconfig.shield
```kconfig
config REDOX_MOD_LEFT
    def_bool $(shields_list_contains,redox_mod_left)

config REDOX_MOD_RIGHT
    def_bool $(shields_list_contains,redox_mod_right)
```
